## meta-deimos/conf/distro/deimos.conf
```bitbake
DISTRO = "deimos"
DISTRO_NAME = "Deimos"
DISTRO_VERSION = "0.0.4"

DISTRO_FEATURES = " opengl wayland systemd pam"
```

## meta-deimos/conf/layer.conf
```bitbake
# We have a conf and classes directory, add to BBPATH
BBPATH =. "${LAYERDIR}:"

# We have recipes-* directories, add to BBFILES
BBFILES += "${LAYERDIR}/recipes-*/*/*.bb \
            ${LAYERDIR}/recipes-*/*/*.bbappend"

BBFILE_COLLECTIONS += "deimos"
BBFILE_PATTERN_deimos = "^${LAYERDIR}/"
BBFILE_PRIORITY_deimos = "5"

LAYERVERSION_deimos = "1"
LAYERSERIES_COMPAT_deimos = "kirkstone honister"

REQUIRED_VERSION_weston = "9.0.0"

VIRTUAL-RUNTIME_init_manager = "systemd"
DISTRO_FEATURES_BACKFILL_CONSIDERED += "sysvinit"
VIRTUAL-RUNTIME_initscripts = "systemd-compact-units"

INIT_MANAGER = "systemd"
```

## meta-frameboard/conf/layer.conf
```bitbake
# We have a conf and classes directory, add to BBPATH
BBPATH .= ":${LAYERDIR}"

# We have a recipes-* directories, add to BBFILES
BBFILES += "${LAYERDIR}/recipes-*/*/*.bb \
	${LAYERDIR}/recipes-*/*/*.bbappend"

BBFILE_COLLECTIONS += "frameboard"
BBFILE_PATTERN_frameboard := "^${LAYERDIR}/"
BBFILE_PRIORITY_frameboard = "6"

FRAMEBOARD_BASE = "${LAYERDIR}"

# This should only be incremented on significant changes that will
# cause compatibility issues with other layers
LAYERVERSION_frameboard = "1"
LAYERSERIES_COMPAT_frameboard = "scarthgap"

# for optee-os-stm32mp dependency
LAYERDEPENDS_frameboard = "core openembedded-layer meta-python"

# OpenSTLinux compatibility version
ST_OSTL_COMPATIBILITY_VERSION_frameboard = "6.0"
```

## meta-ssp/conf/distro/ssp.conf
```bitbake
DISTRO = "ssp"
DISTRO_NAME = "Slideshow player"
DISTRO_VERSION = "0.0.1"

MAINTAINER = "komarovn3@gmail.com"
```

## meta-ssp/conf/layer.conf
```bitbake
# We have a conf and classes directory, add to BBPATH
BBPATH =. "${LAYERDIR}:"

# We have recipes-* directories, add to BBFILES
BBFILES += "${LAYERDIR}/recipes-*/*/*.bb \
            ${LAYERDIR}/recipes-*/*/*.bbappend"

BBFILE_COLLECTIONS += "ssp"
BBFILE_PATTERN_ssp = "^${LAYERDIR}/"
BBFILE_PRIORITY_ssp = "5"

LAYERVERSION_ssp = "1"
LAYERSERIES_COMPAT_ssp = "kirkstone"
```
